## components/idf-gsm/Kconfig
```kconfig
menu "GSM Modem (EC200U)"

    config GSM_UART_PORT_NUM
        int "UART port number"
        default 1
        range 0 2
        help
            UART peripheral to use for modem communication.

    config GSM_UART_BAUD_RATE
        int "UART baud rate"
        default 115200

    config GSM_UART_TX_PIN
        int "UART TX GPIO"
        default 18

    config GSM_UART_RX_PIN
        int "UART RX GPIO"
        default 17

    config GSM_POWER_PIN
        int "Power key GPIO (-1 to disable)"
        default -1
        range -1 48

    config GSM_UART_RX_BUF_SIZE
        int "UART RX ring-buffer size (bytes)"
        default 4096
        range 1024 16384

endmenu
```
